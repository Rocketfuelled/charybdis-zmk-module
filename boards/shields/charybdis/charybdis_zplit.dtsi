
/{
  split_inputs {
    #address-cells = <1>;
    #size-cells = <0>;

    trackball_r_split: trackball_r_split@0 {
        compatible = "zmk,input-split";
        reg = <0>;
    };

    trackball_l_split: trackball_l_split@1 {
        compatible = "zmk,input-split";
        reg = <1>;
    };
  };
};